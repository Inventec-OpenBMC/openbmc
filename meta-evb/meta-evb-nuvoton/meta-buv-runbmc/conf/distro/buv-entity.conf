## meta-evb/meta-evb-nuvoton/meta-buv-runbmc/conf/distro/buv-entity.conf
```bitbake
require conf/distro/openbmc-phosphor.conf

VIRTUAL-RUNTIME_obmc-inventory-manager = "entity-manager"
VIRTUAL-RUNTIME_obmc-sensors-hwmon = "dbus-sensors"
PREFERRED_PROVIDER_virtual/obmc-inventory-data = "entity-manager"

DISTRO = "buv-entity"
DISTRO_NAME = "Nuvoton OpenBMC (Entity Manager)"
DISTRO_FEATURES_append = " buv-entity"
DISTRO_FEATURES_append = " ipmi-fru"
DISTROOVERRIDES .= ":buv-entity"

# Remove unneeded binaries from image
IMAGE_FEATURES_remove = "obmc-health-monitor"
```

## meta-evb/meta-evb-nuvoton/meta-buv-runbmc/conf/machine/buv-runbmc.conf
```bitbake
require conf/machine/include/npcm7xx.inc
require conf/machine/include/obmc-bsp-common.inc

KMACHINE = "nuvoton"
KERNEL_DEVICETREE = "${KMACHINE}-npcm750-buv-runbmc.dtb"

FLASH_SIZE = "65536"
FLASH_UBOOT_OFFSET = "0"
FLASH_KERNEL_OFFSET = "2048"
FLASH_ROFS_OFFSET = "8192"
FLASH_RWFS_OFFSET = "62464"

UBOOT_MACHINE = "PolegRunBMC_defconfig"
UBOOT_DEVICETREE = "nuvoton-npcm750-buv"
IGPS_MACHINE = "RunBMC"

IMAGE_FSTYPES += " cpio.${INITRAMFS_CTYPE}.u-boot"
KERNEL_ALT_IMAGETYPE = "vmlinux"

OBMC_MACHINE_FEATURES += "\
        obmc-phosphor-fan-mgmt \
        obmc-host-ipmi \
        obmc-bmc-state-mgmt \
        obmc-host-state-mgmt \
        obmc-chassis-state-mgmt \
        obmc-bmc-state-mgmt \
        obmc-phosphor-chassis-mgmt \
        "
VIRTUAL-RUNTIME_obmc-host-state-manager = "x86-power-control"
VIRTUAL-RUNTIME_obmc-chassis-state-manager = "x86-power-control"
VIRTUAL-RUNTIME_obmc-discover-system-state = "x86-power-control"

#KCS_DEVICE = "ipmi-kcs1"
#PREFERRED_PROVIDER_virtual/obmc-host-ipmi-hw = "phosphor-ipmi-kcs"
PREFERRED_PROVIDER_virtual/obmc-host-ipmi-hw = "phosphor-ipmi-ssif"
PREFERRED_PROVIDER_virtual/obmc-fan-mgmt = "packagegroup-buv-runbmc-apps"
PREFERRED_PROVIDER_virtual/obmc-system-mgmt = "packagegroup-buv-runbmc-apps"
PREFERRED_PROVIDER_virtual/obmc-chassis-mgmt = "packagegroup-buv-runbmc-apps"

MACHINE_FEATURES += "ext2"

DISTRO_FEATURES_remove = "avahi"
DISTRO_FEATURES_remove = "slp"

IMAGE_FEATURES_remove = "obmc-fan-control"
```

## meta-inventec/meta-goldentalon/conf/machine/goldentalon.conf
```bitbake
KMACHINE = "aspeed"
KERNEL_DEVICETREE = "${KMACHINE}-bmc-opp-${MACHINE}.dtb"

require conf/machine/include/ast2600.inc
require conf/machine/include/obmc-bsp-common.inc
require conf/machine/include/inventec.inc

UBOOT_MACHINE = "goldentalon-ast2600_defconfig"

# To build a 64MB image, set FLASH_SIZE value to "65536".
FLASH_SIZE = "65536"
# Overwrite flash offsets
FLASH_UBOOT_OFFSET = "0"
FLASH_KERNEL_OFFSET = "1024"
FLASH_ROFS_OFFSET = "10240"
FLASH_RWFS_OFFSET = "43008"

PREFERRED_PROVIDER_virtual/phosphor-led-manager-config-native = "goldentalon-led-manager-config-native"
PREFERRED_PROVIDER_virtual/phosphor-ipmi-fru-inventory = "goldentalon-ipmi-inventory-map-native"
PREFERRED_PROVIDER_virtual/phosphor-ipmi-sensor-inventory = "goldentalon-ipmi-sensor-inventory-native"
PREFERRED_PROVIDER_virtual/phosphor-ipmi-inventory-sel = "goldentalon-ipmi-inventory-sel-native"
PREFERRED_PROVIDER_virtual/phosphor-ipmi-fru-read-inventory = "goldentalon-ipmi-fru-read-inventory-native"
```

## meta-inventec/meta-transformers-nuv/conf/distro/buv-dev.conf
```bitbake
require conf/distro/openbmc-phosphor.conf

DISTRO = "buv-dev"
DISTRO_NAME = "Nuvoton OpenBMC (Dev Version)"
DISTRO_FEATURES_append = " buv-dev"
DISTROOVERRIDES .= ":buv-dev"
```

## meta-inventec/meta-transformers-nuv/conf/machine/transformers-nuv.conf
```bitbake
require conf/machine/include/npcm7xx.inc
require conf/machine/include/obmc-bsp-common.inc
require conf/machine/include/inventec.inc

KMACHINE = "nuvoton"
KERNEL_DEVICETREE = "${KMACHINE}-npcm750-buv-runbmc.dtb"

FLASH_SIZE = "65536"
FLASH_UBOOT_OFFSET = "0"
FLASH_KERNEL_OFFSET = "2048"
FLASH_ROFS_OFFSET = "8192"
FLASH_RWFS_OFFSET = "62464"

UBOOT_MACHINE = "PolegRunBMC_defconfig"
UBOOT_DEVICETREE = "nuvoton-npcm750-buv"
IGPS_MACHINE = "RunBMC"

IMAGE_FSTYPES += " cpio.${INITRAMFS_CTYPE}.u-boot"
KERNEL_ALT_IMAGETYPE = "vmlinux"


MACHINE_FEATURES += "ext2"

DISTRO_FEATURES_remove = "avahi"
DISTRO_FEATURES_remove = "slp"

IMAGE_FEATURES_remove = "obmc-fan-control"

PREFERRED_PROVIDER_virtual/phosphor-ipmi-fru-inventory = "transformers-nuv-ipmi-fru-inventory-native"
PREFERRED_PROVIDER_virtual/phosphor-ipmi-fru-read-inventory = "transformers-nuv-ipmi-fru-read-inventory-native"
PREFERRED_PROVIDER_virtual/phosphor-ipmi-fru-properties = "transformers-nuv-ipmi-fru-properties-native"
```
